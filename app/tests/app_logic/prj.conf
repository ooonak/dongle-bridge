## CMakeLists.txt
```
# tests/unit/CMakeLists.txt

cmake_minimum_required(VERSION 3.20.0)

set(CMAKE_VERBOSE_MAKEFILE ON)
set(CMAKE_EXPORT_COMPILE_COMMANDS ON)

find_package(Zephyr REQUIRED HINTS $ENV{ZEPHYR_BASE})

project(app_logic_tests)

include(../../cmake/flags.cmake)

# Test sources
target_sources(app PRIVATE
    src/test_app_logic.c
    src/fake_port.c

    # Pull in the real app logic
    ${CMAKE_CURRENT_LIST_DIR}/../../src/app/app_logic.c
)

# Include project headers
target_include_directories(app PRIVATE
    ${CMAKE_CURRENT_LIST_DIR}/../../include
)
```

## prj.conf
```kconfig
# tests/unit/prj.conf

CONFIG_ZTEST=y
#CONFIG_ZTEST_ASSERT_VERBOSE=y

# Native simulator
#CONFIG_NATIVE_SIM=y

CONFIG_LOG=y
CONFIG_PRINTK=y

# Disable everything we don't need
#CONFIG_USB=n
#CONFIG_BT=n
```

## src/fake_port.c
```c
#include <string.h>
#include "port.h"
#include "msg.h"

/* Test-visible state */
enum port_id fake_last_port;
size_t fake_last_len;
uint8_t fake_last_data[MSG_MAX_LEN];
int fake_send_count;

void fake_port_reset(void)
{
    fake_last_port = -1;
    fake_last_len = 0;
    fake_send_count = 0;
}

/* ---- port interface implementation ---- */

void port_send(enum port_id port,
               const uint8_t *data,
               size_t len)
{
    fake_last_port = port;
    fake_last_len = len;
    fake_send_count++;

    if (len > 0 && data != NULL) {
        memcpy(fake_last_data, data, len);
    }
}
```

## src/test_app_logic.c
```c
#include <zephyr/ztest.h>
#include "app_logic.h"
#include "port.h"
#include "usb_if.h"
#include "ble_if.h"

/* From fake_port.c */
extern enum port_id fake_last_port;
extern size_t fake_last_len;
extern uint8_t fake_last_data[];
extern int fake_send_count;
void fake_port_reset(void);

/* ---------------- Test helpers ---------------- */

static const uint8_t REQ_USB[] = { 0x01, 0x02 };
static const uint8_t RESP_USB[] = { 0x10 };

static const uint8_t REQ_BLE[] = { 0x03 };
static const uint8_t RESP_BLE[] = { 0x20, 0x21 };

/* ---------------- Tests ---------------- */

ZTEST(app_logic, test_usb_initiates_transaction)
{
    fake_port_reset();

    /* USB sends request */
    app_on_rx(PORT_USB, REQ_USB, sizeof(REQ_USB));

    zassert_equal(fake_last_port, PORT_BLE);
    zassert_equal(fake_last_len, sizeof(REQ_USB));

    /* BLE responds */
    app_on_response(PORT_BLE, RESP_BLE, sizeof(RESP_BLE));

    zassert_equal(fake_last_port, PORT_USB);
    zassert_equal(fake_last_len, sizeof(RESP_BLE));
}

ZTEST(app_logic, test_ble_initiates_transaction)
{
    fake_port_reset();

    /* BLE sends request */
    app_on_rx(PORT_BLE, REQ_BLE, sizeof(REQ_BLE));

    zassert_equal(fake_last_port, PORT_USB);
    zassert_equal(fake_last_len, sizeof(REQ_BLE));

    /* USB responds */
    app_on_response(PORT_USB, RESP_USB, sizeof(RESP_USB));

    zassert_equal(fake_last_port, PORT_BLE);
    zassert_equal(fake_last_len, sizeof(RESP_USB));
}

ZTEST(app_logic, test_independent_directions_allowed)
{
    fake_port_reset();

    /* USB initiates USB→BLE */
    app_on_rx(PORT_USB, REQ_USB, sizeof(REQ_USB));
    zassert_equal(fake_last_port, PORT_BLE);

    /* BLE initiates BLE→USB simultaneously */
    app_on_rx(PORT_BLE, REQ_BLE, sizeof(REQ_BLE));
    zassert_equal(fake_last_port, PORT_USB);

    /* BLE responds to USB request */
    app_on_response(PORT_BLE, RESP_BLE, sizeof(RESP_BLE));
    zassert_equal(fake_last_port, PORT_USB);

    /* USB responds to BLE request */
    app_on_response(PORT_USB, RESP_USB, sizeof(RESP_USB));
    zassert_equal(fake_last_port, PORT_BLE);
}

ZTEST(app_logic, test_busy_rejected_per_direction)
{
    fake_port_reset();

    /* USB initiates */
    app_on_rx(PORT_USB, REQ_USB, sizeof(REQ_USB));
    zassert_equal(fake_last_port, PORT_BLE);

    /* USB tries again while busy */
    app_on_rx(PORT_USB, REQ_USB, sizeof(REQ_USB));

    /* Should reply BUSY to USB */
    zassert_equal(fake_last_port, PORT_USB);
    zassert_true(fake_last_len > 0);
}

/* ---------------- Suite ---------------- */

ZTEST_SUITE(app_logic, NULL, NULL, NULL, NULL, NULL);
```
