## CMakeLists.txt
```
#-------------------------------------------------------------------------------
# Zephyr Dongle Bridge Application
#
# Copyright (c) 2021 Nordic Semiconductor ASA
# SPDX-License-Identifier: Apache-2.0

cmake_minimum_required(VERSION 3.13.1)

set(CMAKE_VERBOSE_MAKEFILE ON)
set(CMAKE_EXPORT_COMPILE_COMMANDS ON)

find_package(Zephyr REQUIRED HINTS $ENV{ZEPHYR_BASE})

project(app LANGUAGES C)

include(cmake/flags.cmake)

# Include app headers
zephyr_include_directories(include)

# Include app sources
set(SOURCES
  src/main.c
  src/app/app_logic.c
  src/app/ble_event.c
  src/app/port.c
  src/app/usb_event.c
  src/hal/ble_if_zephyr.c
  src/hal/usb_if_zephyr.c
)

target_sources(app PRIVATE ${SOURCES})

# The code below locates the git index file for this repository and adds it as a dependency for
# the application VERSION file so that if the repo has a new commit added, even if no files in
# the build have changed, the application version file will be regenerated with the new git commit
find_package(Git QUIET)
if(GIT_FOUND)
  execute_process(
    COMMAND ${GIT_EXECUTABLE} rev-parse --absolute-git-dir
    WORKING_DIRECTORY .
    OUTPUT_VARIABLE application_git_dir
    OUTPUT_STRIP_TRAILING_WHITESPACE
    ERROR_STRIP_TRAILING_WHITESPACE
    ERROR_VARIABLE stderr
    RESULT_VARIABLE return_code
  )
  # If there is an error e.g. it is not a git repo, we just silently ignore it and continue
  # without a dependency, this will be the case with freestanding applications.
  if(NOT return_code)
    if(NOT "${stderr}" STREQUAL "")
      message(WARNING "Application build version git rev-parse warned: ${stderr}")
    endif()

    set_property(TARGET app_version_h PROPERTY APP_VERSION_DEPENDS ${application_git_dir}/index)
  endif()
endif()
```

## sample.yaml
```
# This file is provided so that the application can be compiled using Twister,
# the Zephyr testing tool. In this file, multiple combinations can be specified,
# so that you can easily test all of them locally or in CI.
sample:
  description: Dongle bridge application
  name: dongle-bridge
common:
  build_only: true
  integration_platforms:
    - nrf52840dongle
tests:
  app.default: {}
```

## prj.conf
```kconfig
CONFIG_PRINTK=y
CONFIG_CONSOLE=y
CONFIG_UART_CONSOLE=y
CONFIG_LOG=y
CONFIG_LOG_MODE_IMMEDIATE=y
```

## src/main.c
```c
/* src/main.c */

#include <zephyr/kernel.h>

#include "usb_if.h"
#include "ble_if.h"

/* Optional: logging */
#include <zephyr/logging/log.h>
LOG_MODULE_REGISTER(main, LOG_LEVEL_INF);

int main(void)
{
    int ret;

    LOG_INF("USB ↔ BLE bridge starting");

    /* Initialize USB transport */
    ret = usb_if_init();
    if (ret) {
        LOG_ERR("USB init failed: %d", ret);
        return ret;
    }

    /* Initialize BLE transport */
    ret = ble_if_init();
    if (ret) {
        LOG_ERR("BLE init failed: %d", ret);
        return ret;
    }

    LOG_INF("Transports initialized");

    /* Nothing else to do:
     * - USB RX handled by usb_event
     * - BLE RX handled by ble_event
     * - app_logic reacts to events
     */
    return 0;
}
```

## include/app_logic.h
```c
#pragma once
#include "msg.h"
#include "port.h"
#include "transaction.h"

void app_on_rx(enum port_id from, const uint8_t *data, size_t len);

void app_on_response(enum port_id from, const uint8_t *data, size_t len);
```

## include/ble_if.h
```c
#pragma once

#include <stddef.h>
#include <stdint.h>
#include <stdbool.h>

#include "msg.h"

/*
 * BLE transport interface
 *
 * - TX only
 * - RX handled by ble_event.c
 * - Asynchronous
 * - One message at a time (enforced by app_logic)
 */

int ble_if_init(void);

/*
 * Send a message over BLE.
 *
 * Returns:
 *  0          message accepted for transmission
 * -EBUSY      BLE stack busy
 * -EINVAL     invalid length (> MSG_MAX_LEN)
 * -ENOTCONN   not connected
 */
int ble_if_send_async(const uint8_t *data, size_t len);
```

## include/msg.h
```c
#pragma once
#include <stddef.h>
#include <stdint.h>

#define MSG_MAX_LEN 238

struct msg {
    size_t len;
    uint8_t data[MSG_MAX_LEN];
};
```

## include/port.h
```c
#pragma once
#include <stddef.h>
#include <stdint.h>

enum port_id {
    PORT_USB,
    PORT_BLE,
    // future ports
};

void port_send(enum port_id port, const uint8_t *data, size_t len);

void port_register_rx_callback(enum port_id port,
                               void (*cb)(const uint8_t *data, size_t len));
```

## include/sum.h
```c
#ifndef SUM_H
#define SUM_H

int add(int a, int b);

#endif /* SUM_H */
```

## include/transaction.h
```c
#pragma once
#include <stddef.h>
#include <stdbool.h>
#include "msg.h"

struct txn {
    bool busy;
    struct msg message;
};
```

## include/usb_if.h
```c
#pragma once
#include <stddef.h>
#include <stdint.h>
#include "msg.h"

struct usb_evt {
    void *fifo_reserved;
    size_t len;
    uint8_t data[MSG_MAX_LEN];
};

int usb_if_init(void);

int usb_if_send_async(const uint8_t *data, size_t len);
```

## src/sum.c
```c
#include "sum.h"

int add(int a, int b)
{
    return a + b;
}
```
